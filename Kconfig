## Kconfig
```kconfig
menu "RTC"
	menu "RV-8263-C7 RTC Driver"
		choice
			prompt "I2C port"
			default I2C_RV2863_0_ENABLED

			config I2C_RV2863_0_ENABLED
				bool "Enable I2C port 0"
			config I2C_RV2863_1_ENABLED
				bool "Enable I2C port 1"
		endchoice

		config EPOCH_YEAR
			int "EPOCH Year"
			default 1900
			help
				The Year where the EPOCH started
		config TIME_ZONE
			string "Enter a TZ-Variable (standardized POSIX string)"
			default "CET-1CEST,M3.5.0,M10.5.0/3"
			help
				Used to update C library runtime data for the new time zone.
				With this, localtime function will return correct local time,
				taking time zone offset and daylight saving time into account.
				Default is for Europe/Paris timezone.
	endmenu
endmenu
```
